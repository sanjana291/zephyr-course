## app/Kconfig
```kconfig
source "Kconfig.zephyr"
menuconfig LED_SUBSYSTEM
    bool "LED Subsystem"
    help
      Top-level toggle for the LED subsystem.


if LED_SUBSYSTEM

choice
    prompt "LED blink sleep time"
    default BLINK_TIME_1S

    config BLINK_TIME_250MS
        bool "250ms (fast)"
    config BLINK_TIME_500MS
        bool "500ms"
    config BLINK_TIME_1S
        bool "1s (medium)"
    config BLINK_TIME_2S
        bool "2s (slow)"
endchoice


config BLINK_TIME_MS
    int
    default 250 if BLINK_TIME_250MS
    default 500 if BLINK_TIME_500MS
    default 1000 if BLINK_TIME_1S
    default 2000 if BLINK_TIME_2S

menuconfig ADVANCED_LED_SETTINGS
    bool "Advanced LED settings"

if ADVANCED_LED_SETTINGS

config LED_BRIGHTNESS
    int "LED brightness (0-100)"
    range 0 100
    default 100

config LED_FADE_DURATION
    int "LED fade duration (ms)"
    range 0 5000
    default 500

endif # ADVANCED_LED_SETTINGS

endif # LED_SUBSYSTEM


menu "Expert settings"
    visible if LED_SUBSYSTEM

    config LED_DEBUGGING
        bool "Enable LED debugging"

    config CUSTOM_BLINK_PATTERN
        bool "Custom blink pattern"

endmenu
```
